// zmk/app/boards/shields/apollo32/apollo32.overlay

#include <dt-bindings/gpio/gpio.h>
#include <dt-bindings/input/input-event-codes.h>
#include <dt-bindings/zmk/kscan.h>
#include <dt-bindings/zmk/matrix_transform.h>

/ {
    compatible = "zmk,shield";
    label = "apollo32"; // あなたのシールドのラベル

    kscan0: kscan {
        compatible = "zmk,kscan-gpio-matrix";
        label = "KSCAN";
        diode-direction = "col2row"; // あなたのダイオードの向きに合わせてください

        row-gpios = <&gpio0 17 (GPIO_ACTIVE_HIGH | GPIO_PULL_DOWN) // D2 = Row_0
                     &gpio0 31 (GPIO_ACTIVE_HIGH | GPIO_PULL_DOWN) // D21 = Row_1
                     &gpio0 22 (GPIO_ACTIVE_HIGH | GPIO_PULL_DOWN) // D20 = Row_2
                    >;

        col-gpios = <&gpio0 24 GPIO_ACTIVE_HIGH  // D4 = Col_0
                     &gpio0 22 GPIO_ACTIVE_HIGH  // D5 = Col_1
                     &gpio0 9  GPIO_ACTIVE_HIGH  // D9 = Col_2
                     &gpio0 4  GPIO_ACTIVE_HIGH  // D8 = Col_3
                     &gpio0 11 GPIO_ACTIVE_HIGH  // D7 = Col_4
                     &gpio0 1  GPIO_ACTIVE_HIGH  // D6 = Col_5
                     &gpio0 10 GPIO_ACTIVE_HIGH  // D10 = Col_6
                     &gpio1 15 GPIO_ACTIVE_HIGH  // D16 = Col_7
                     &gpio1 13 GPIO_ACTIVE_HIGH  // D14 = Col_8
                     &gpio1 14 GPIO_ACTIVE_HIGH  // D15 = Col_9
                     &gpio1 18 GPIO_ACTIVE_HIGH  // D18 = Col_10
                    >;
    };

    default_transform: matrix_transform {
        compatible = "zmk,matrix-transform-row-col";
        columns = <11>; // あなたのキーボードの列数
        rows = <3>;    // あなたのキーボードの行数
    };
};
